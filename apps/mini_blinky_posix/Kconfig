## apps/mini_blinky_posix/Kconfig
```kconfig
#
# For a description of the syntax of this configuration file,
# see the file kconfig-language.txt in the NuttX tools repository.
#

config RAILAB_MINIMAL_BLINKY1
	tristate "Minimal blinky example with files"
	default n
	---help---
		Enable the minimal blinky example with files

if RAILAB_MINIMAL_BLINKY1

config RAILAB_MINIMAL_BLINKY1_STACKSIZE
	int "App stack size"
	default DEFAULT_TASK_STACKSIZE

endif # RAILAB_MINIMAL_BLINKY1
```

## apps/mini_blinky_stm32/Kconfig
```kconfig
#
# For a description of the syntax of this configuration file,
# see the file kconfig-language.txt in the NuttX tools repository.
#

config RAILAB_MINIMAL_BLINKY2
	tristate "Minimal blinky example with files"
	default n
	---help---
		Enable the minimal blinky example with files

if RAILAB_MINIMAL_BLINKY2

config RAILAB_MINIMAL_BLINKY2_STACKSIZE
	int "App stack size"
	default DEFAULT_TASK_STACKSIZE

endif # RAILAB_MINIMAL_BLINKY2
```

## apps/mini_cannode/Kconfig
```kconfig
#
# For a description of the syntax of this configuration file,
# see the file kconfig-language.txt in the NuttX tools repository.
#

config RAILAB_MINIMAL_CANNODE
	tristate "Minimal CAN node example (character device)"
	default n
	---help---
		Enable the minimal CAN node example

if RAILAB_MINIMAL_CANNODE

config RAILAB_MINIMAL_CANNODE_STACKSIZE
	int "App stack size"
	default DEFAULT_TASK_STACKSIZE

config RAILAB_MINIMAL_CANNODE_RX_STACKSIZE
	int "CAN RX task stack size"
	default 512

config RAILAB_MINIMAL_CANNODE_TX_STACKSIZE
	int "CAN TX task stack size"
	default 512

choice
	prompt "CAN stack used"
	default RAILAB_MINIMAL_CANNODE_INVAL

config RAILAB_MINIMAL_CANNODE_CHARDEV
	bool "CAN character device"
	depends on CAN

config RAILAB_MINIMAL_CANNODE_SOCKET
	bool "CAN SocketCAN interface"
	depends on NET_CAN

config RAILAB_MINIMAL_CANNODE_INVAL
	bool "CAN interface not selected"

endchoice # CAN stack used

config RAILAB_MINIMAL_CANNODE_NODEID
	hex "CAN node ID (mask 0xf00)"
	default 0x100

config RAILAB_MINIMAL_CANNODE_HBSEC
	int "CAN node heartbeat time in seconds"
	default 1

config RAILAB_MINIMAL_CANNODE_DUMMY
	bool "CAN node use dummy USERLEDS and BUTTON"
	default n
	---help---
		Simulate USERLEDS nad BUTTONS driver

endif # RAILAB_MINIMAL_CANNODE
```

## apps/mini_components1/Kconfig
```kconfig
#
# For a description of the syntax of this configuration file,
# see the file kconfig-language.txt in the NuttX tools repository.
#

config RAILAB_MINIMAL_COMPONENTS1
	tristate "Minimal NuttX components example 1"
	default n
	---help---
		Enable the minimal NuttX components example 1

if RAILAB_MINIMAL_COMPONENTS1

config RAILAB_MINIMAL_COMPONENTS1_STACKSIZE
	int "App stack size"
	default DEFAULT_TASK_STACKSIZE

endif # RAILAB_MINIMAL_COMPONENTS1
```

## apps/mini_components2/Kconfig
```kconfig
#
# For a description of the syntax of this configuration file,
# see the file kconfig-language.txt in the NuttX tools repository.
#

config RAILAB_MINIMAL_COMPONENTS2
	tristate "Minimal NuttX components example 2"
	default n
	---help---
		Enable the minimal NuttX components example 2

if RAILAB_MINIMAL_COMPONENTS2

config RAILAB_MINIMAL_COMPONENTS2_STACKSIZE
	int "App stack size"
	default DEFAULT_TASK_STACKSIZE

config RAILAB_MINIMAL_COMPONENTS2_TIMERFD
	bool "Enable timers"
	default n
	depends on TIMER_FD

config RAILAB_MINIMAL_COMPONENTS2_POLL
	bool "Enable poll interface"
	depends on RAILAB_MINIMAL_COMPONENTS2_TIMERFD
	depends on TIMER_FD_POLL
	default n

config RAILAB_MINIMAL_COMPONENTS2_EPOLL
	bool "Enable poll interface"
	depends on RAILAB_MINIMAL_COMPONENTS2_TIMERFD
	default n

endif # RAILAB_MINIMAL_COMPONENTS2
```

## apps/mini_components3/Kconfig
```kconfig
#
# For a description of the syntax of this configuration file,
# see the file kconfig-language.txt in the NuttX tools repository.
#

config RAILAB_MINIMAL_COMPONENTS3
	tristate "Minimal NuttX components example 3"
	default n
	---help---
		Enable the minimal NuttX components example 3

if RAILAB_MINIMAL_COMPONENTS3

config RAILAB_MINIMAL_COMPONENTS3_STACKSIZE
	int "App stack size"
	default DEFAULT_TASK_STACKSIZE

config RAILAB_MINIMAL_COMPONENTS3_THREADS
	bool "enable threads"
	depends on !CONFIG_DISABLE_PTHREAD
	default n

config RAILAB_MINIMAL_COMPONENTS3_ATOMIC
	bool "enable data with atomic"
	depends on RAILAB_MINIMAL_COMPONENTS3_THREADS
	default n

config RAILAB_MINIMAL_COMPONENTS3_MUTEX
	bool "enable data with mutex"
	depends on RAILAB_MINIMAL_COMPONENTS3_THREADS
	default n

config RAILAB_MINIMAL_COMPONENTS3_COND
	bool "enable data with conditional"
	depends on RAILAB_MINIMAL_COMPONENTS3_THREADS
	default n

config RAILAB_MINIMAL_COMPONENTS3_RWLOCK
	bool "enable data with rwlock"
	depends on RAILAB_MINIMAL_COMPONENTS3_THREADS
	default n

endif # RAILAB_MINIMAL_COMPONENTS3
```

## apps/mini_components4/Kconfig
```kconfig
#
# For a description of the syntax of this configuration file,
# see the file kconfig-language.txt in the NuttX tools repository.
#

config RAILAB_MINIMAL_COMPONENTS4
	tristate "Minimal NuttX components example 4"
	default n
	---help---
		Enable the minimal NuttX components example 4

if RAILAB_MINIMAL_COMPONENTS4

config RAILAB_MINIMAL_COMPONENTS4_STACKSIZE
	int "App stack size"
	default DEFAULT_TASK_STACKSIZE

config RAILAB_MINIMAL_COMPONENTS4_POSIXTIMER
	bool "singal with POSIX timer"
	depends on !CONFIG_DISABLE_PTHREAD
	default n

config RAILAB_MINIMAL_COMPONENTS4_POSIXTIMER_SIGENV
	bool "singal with POSIX timer"
	depends on RAILAB_MINIMAL_COMPONENTS4_POSIXTIMER
	depends on SIG_EVTHREAD
	default n

config RAILAB_MINIMAL_COMPONENTS4_THREAD
	bool "singal with thread thread"
	depends on !CONFIG_DISABLE_POSIX_TIMERS
	default n

endif # RAILAB_MINIMAL_COMPONENTS4
```

## apps/mini_components5/Kconfig
```kconfig
#
# For a description of the syntax of this configuration file,
# see the file kconfig-language.txt in the NuttX tools repository.
#

config RAILAB_MINIMAL_COMPONENTS5
	tristate "Minimal NuttX components example 5"
	default n
	---help---
		Enable the minimal NuttX components example 5

if RAILAB_MINIMAL_COMPONENTS5

config RAILAB_MINIMAL_COMPONENTS5_STACKSIZE
	int "App stack size"
	default DEFAULT_TASK_STACKSIZE

config RAILAB_MINIMAL_COMPONENTS5_LIBC_FLOAT
	bool "Enable float print"
	default n
	depends on LIBC_FLOATINGPOINT

config RAILAB_MINIMAL_COMPONENTS5_LIBC_LONGLONG
	bool "Enable long long print"
	default n
	depends on LIBC_LONG_LONG

config RAILAB_MINIMAL_COMPONENTS5_LIBM
	bool "Enable libm test"
	default n
	depends on RAILAB_MINIMAL_COMPONENTS5_LIBC_FLOAT

config RAILAB_MINIMAL_COMPONENTS5_FIXEDMATH
	bool "Enable fixed math test"
	default n

config RAILAB_MINIMAL_COMPONENTS5_FLOATMATH
	bool "Enable float math test"
	default n

endif # RAILAB_MINIMAL_COMPONENTS5
```

## apps/mini_hello/Kconfig
```kconfig
#
# For a description of the syntax of this configuration file,
# see the file kconfig-language.txt in the NuttX tools repository.
#

config RAILAB_MINIMAL_HELLO
	tristate "Minimal hello example"
	default n
	---help---
		Enable the minimal hello example

if RAILAB_MINIMAL_HELLO

config RAILAB_MINIMAL_HELLO_STACKSIZE
	int "App stack size"
	default DEFAULT_TASK_STACKSIZE

endif # RAILAB_MINIMAL_HELLO
```

## apps/mini_modbusslave/Kconfig
```kconfig
#
# For a description of the syntax of this configuration file,
# see the file kconfig-language.txt in the NuttX tools repository.
#

config RAILAB_MINIMAL_MODBUSSLAVE
	tristate "Minimal Modbus slave example"
	default n
	---help---
		Enable the minimal Modbus slave example

if RAILAB_MINIMAL_MODBUSSLAVE

config RAILAB_MINIMAL_MODBUSSLAVE_STACKSIZE
	int "App stack size"
	default DEFAULT_TASK_STACKSIZE

config RAILAB_MINIMAL_MODBUSSLAVE_SLAVEID
	int "Modbus slave ID"
	default 1
	range 1 255

endif # RAILAB_MINIMAL_MODBUSSLAVE
```

## apps/mini_oscore/Kconfig
```kconfig
#
# For a description of the syntax of this configuration file,
# see the file kconfig-language.txt in the NuttX tools repository.
#

config RAILAB_MINIMAL_OSCORE
	tristate "Minimal OS core example"
	default n
	---help---
		Enable the minimal OS core example

if RAILAB_MINIMAL_OSCORE

config RAILAB_MINIMAL_OSCORE_STACKSIZE
	int "App stack size"
	default DEFAULT_TASK_STACKSIZE

endif # RAILAB_MINIMAL_OSCORE
```
